#ifndef SDWORKERTASK_H
#define SDWORKERTASK_H
//------------------------------------------------------------------------------------
#include "stm32f4xx_hal.h"
#include "cmsis_os.h"

#include "fatfs.h"

#include "UartDebug.h"
//------------------------------------------------------------------------------------
/* USER CODE BEGIN PV */
/* Private variables ------------------------------------------*/
FATFS SDFatFs; /* File system object for SD card logical drive */
FIL MyFile; /* File object */
const char wtext[] = "Hello World!";
const uint8_t image1_bmp[] = {
0x42,0x4d,0x36,0x84,0x03,0x00,0x00,0x00,0x00,0x00,0x36,0x00,0x00,0x00,
0x28,0x00,0x00,0x00,0x40,0x01,0x00,0x00,0xf0,0x00,0x00,0x00,0x01,0x00,
0x18,0x00,0x00,0x00,0x00,0x00,0x00,0x84,0x03,0x00,0x00,0x00,0x00,0x00,
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0x65,0x30,0x82,0x6d,0x0f,0x6c,0x3e,0x22,0x80,0x5d,0x23,0x8b,0x5b,0x26};
/* USER CODE END PV */
//------------------------------------------------------------------------------------
/* USER CODE BEGIN 1 */
FRESULT res; /* FatFs function common result code */
uint32_t byteswritten, bytesread; /* File write/read counts */
char rtext[256]; /* File read buffer */
/* USER CODE END 1 */
//------------------------------------------------------------------------------------


//------------------------------------------------------------------------------------
void StartSdWorkerTask(void const * argument);

//------------------------------------------------------------------------------------
#endif // SDWORKERTASK_H
